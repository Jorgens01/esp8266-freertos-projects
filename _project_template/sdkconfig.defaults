## _project_template/sdkconfig.defaults
```kconfig
CONFIG_ESPTOOLPY_PORT="/dev/ttyUSB0"
CONFIG_ESPTOOLPY_BAUD_115200B=y
CONFIG_ESPTOOLPY_BAUD=115200
CONFIG_ESPTOOLPY_COMPRESSED=y
CONFIG_FLASHMODE_QIO=y
CONFIG_ESPTOOLPY_FLASHMODE="qio"
CONFIG_ESPTOOLPY_FLASHFREQ_40M=y
CONFIG_ESPTOOLPY_FLASHFREQ="40m"
CONFIG_ESPTOOLPY_FLASHSIZE_2MB=y
CONFIG_ESPTOOLPY_FLASHSIZE="2MB"
CONFIG_LOG_DEFAULT_LEVEL_INFO=y
CONFIG_BOOTLOADER_LOG_LEVEL_INFO=y
```

## wifi-weather/main/Kconfig.projbuild
```kconfig
menu "Project Configuration"

    config WIFI_SSID
        string "WiFi SSID"
        default "MySSID"
        help
            SSID of your WiFi network.

    config WIFI_PASSWORD
        string "WiFi Password"
        default "MyPassword"
        help
            Password for your WiFi network.

    config WEATHER_API_KEY
        string "OpenWeatherMap API Key"
        default ""
        help
            Your API key from openweathermap.org.

    config WEATHER_CITY
        string "City Name"
        default ""
        help
            The city to get weather for.

endmenu
```
